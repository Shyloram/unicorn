## Kconfig
```kconfig
#
# For a description of the syntax of this configuration file,
# see config/Kconfig-language.txt
#
mainmenu "Zmodo App Configuration"

menu "Platform"

choice
    prompt "suppliers name"
    default ZMD_APP_HISI
    help
      select suppliers name.

config ZMD_APP_HISI
    bool "Hisilicon"
endchoice

choice
    depends on  ZMD_APP_HISI
    prompt "OS Type"
    default ZMD_APP_HISI_LINUX
    help
      select OS type.
	  
config ZMD_APP_HISI_LINUX
    bool "Linux"
endchoice

choice
    depends on  ZMD_APP_HISI
    prompt "Chip Type"
    default ZMD_APP_HI3519A100
    help
      select Chip type.

config ZMD_APP_HI3519A100
    bool "hi3519A100"
endchoice
endmenu

source "src/Kconfig"
source "thirdparty/Kconfig"

menuconfig ZMD_APP_DEBUG 
	bool "Debug Log Switch"
	default y
	help
		this module provide extra debug log.

if ZMD_APP_DEBUG

config ZMD_APP_DEBUG_ITF
	bool "interface debug log"
	default y
	help
		this module provide interface debug log.

config ZMD_APP_DEBUG_AUD
	depends on ZMD_APP_ENCODE_AUDIO
	bool "audio debug log"
	default y
	help
		this module provide audio debug log.

config ZMD_APP_DEBUG_BUF
	depends on ZMD_APP_ENCODE_BUFFERMANAGE
	bool "buffer manage debug log"
	default y
	help
		this module provide buffer manage debug log.

config ZMD_APP_DEBUG_VID
	depends on ZMD_APP_ENCODE_VIDEO
	bool "video debug log"
	default y
	help
		this module provide video debug log.
		
config ZMD_APP_DEBUG_ZSP
	depends on ZMD_APP_ZSP
	bool "ZSP debug log"
	default y
	help
		this module provide ZSP debug log.

config ZMD_APP_DEBUG_MSH
	depends on ZMD_APP_MESHARE
	bool "meshare debug log"
	default y
	help
		this module provide meshare debug log.
endif

menu "Release Note"

config ZMD_APP_SOFTWARE_VERSION
	string "sortware version"
	default "V0.0.0.01"
	help
		this is sortware version number

config ZMD_APP_HARDWARE_VERSION
	string "hardware version"
	default "V0.0.0.01"
	help
		this is hardware version number

endmenu
```

## src/Kconfig
```kconfig
menu "Function Module"

menuconfig ZMD_APP_ENCODE
    bool "media function module"
	default y
	select ZMD_APP_ENCODE_VIDEO
	select ZMD_APP_ENCODE_BUFFERMANAGE
	help
		this module provide video encode,audio encode and decode,buffer manage function etc.

source src/encode/Kconfig

config ZMD_APP_RTSP
	bool "rtsp server"
	default n
	help
		this module provide rtsp server.

config ZMD_APP_MESHARE
    bool "meshare function module"
	default y
	select ZMD_APP_THREADPOOL
	select ZMD_APP_THI_MBEDTLS 
	select ZMD_APP_THI_CURL
	select ZMD_APP_THI_JSON
	select ZMD_APP_THI_NOPOLL 
	help
		this module provide network connect to meshare cloud.

config ZMD_APP_ZSP
    bool "zmdnetlib function module"
	default y
	select ZMD_APP_THREADPOOL
	select ZMD_APP_THI_MBEDTLS 
	help
		this module provide network connect to PC tool.

config ZMD_APP_THREADPOOL
    bool "threadpool function module"
	default n
	help
		this module provide network connect to meshare cloud API.
		
endmenu
```

## src/encode/Kconfig
```kconfig
if ZMD_APP_ENCODE

#video config
config ZMD_APP_ENCODE_VIDEO
    bool "video function module"
	default y
	help
		this module provide video encode and config option function etc.

config ZMD_APP_ENCODE_VIDEO_MAX_CH_SRTEAM
	depends on ZMD_APP_ENCODE_VIDEO
	int "total channel number(1~3)"
	range 1 3
	default 3

config ZMD_APP_ENCODE_AUDIO
    bool "audio function module"
	default y
	help
		this module provide audio encode, decode and play function.

config ZMD_APP_ENCODE_BUFFERMANAGE
    bool "buffer manage function module"
	default y
	help
		this module provide source buffer manage function.

config ZMD_APP_ENCODE_BUFFERMANAGE_IFRAME_ENCRYPTION
	depends on ZMD_APP_ENCODE_BUFFERMANAGE
	bool "I Frame encryption"
	default y
	select ZMD_APP_THI_MBEDTLS
	help
		it will encrypt the I frame.

endif #ZMD_APP_ENCODE
```

## thirdparty/Kconfig
```kconfig
menu "Thirdparty"

config ZMD_APP_THI_CURL
    bool "curl-7.59.0"
	default n
	help
		command line tool and library for transferring data with URLs

config ZMD_APP_THI_JSON
    bool "json-c-0.13"
	default n
	help
		JSON (JavaScript Object Notation) is a lightweight data-interchange format. 

config ZMD_APP_THI_MBEDTLS
    bool "mbedtls-2.9.0"
	default n
	help
		mbed TLS (formerly known as PolarSSL) makes it trivially easy for developers to 
		include cryptographic and SSL/TLS capabilities in their (embedded) products, 
		facilitating this functionality with a minimal coding footprint.

config ZMD_APP_THI_NOPOLL
    bool "nopoll-encrypt"
	default n
	help
		noPoll is a OpenSource WebSocket implementation (RFC 6455), written in ansi C, 
		that allows building pure WebSocket solutions or to provide WebSocket support to existing TCP oriented applications.

endmenu
```
